## config/boards/shields/zenFlow/Kconfig.defconfig
```kconfig
if SHIELD_ZENFLOW_LEFT

config ZMK_KEYBOARD_NAME
    default "The ZenFlow"

config ZMK_SPLIT_ROLE_CENTRAL
    default y

endif

if SHIELD_ZENFLOW_LEFT || SHIELD_ZENFLOW_RIGHT
config ZMK_SPLIT
    default y
endif
```

## config/boards/shields/zenFlow/Kconfig.shield
```kconfig
config SHIELD_ZENFLOW_LEFT
    def_bool $(shields_list_contains,zenFlow_left)

config SHIELD_ZENFLOW_RIGHT
    def_bool $(shields_list_contains,zenFlow_right)
```

## config/west.yml
```yaml
# mouse integration
#manifest:
#  remotes:
#    - name: zmkfirmware
#      url-base: https://github.com/zmkfirmware
#    - name: caksoylar
#      url-base: https://github.com/caksoylar
#  projects:
#    - name: zmk
#      remote: caksoylar
#      revision: feat/mouse-keys-3.2
#      import: app/west.yml
#  self:
#    path: config
    
    
manifest:
  remotes:
    - name: zmkfirmware
      url-base: https://github.com/zmkfirmware
    - name: petejohanson
      url-base: https://github.com/petejohanson
      
    # Additional modules containing boards/shields/custom code can be listed here as well
    # See https://docs.zephyrproject.org/3.2.0/develop/west/manifest.html#projects
  projects:
    - name: zmk
      remote: petejohanson
      revision: feat/pointers-move-scroll
      import: app/west.yml
  self:
    path: config
```
